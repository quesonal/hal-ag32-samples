## CMakeLists.txt
```
# SPDX-License-Identifier: Apache-2.0

cmake_minimum_required(VERSION 3.28.0)
find_package(Zephyr REQUIRED HINTS $ENV{ZEPHYR_BASE})
project(usb_cdc_echo)

# Reuse the upstream CDC-ACM sample's shared usbd-init helper (sample_usbd.h
# + sample_usbd_init.c) — no need to fork those into hal_ag32.
include(${ZEPHYR_BASE}/samples/subsys/usb/common/common.cmake)

FILE(GLOB app_sources src/*.c)
target_sources(app PRIVATE ${app_sources})
```

## Kconfig
```
# SPDX-License-Identifier: Apache-2.0

# Pull in the upstream USB sample options (SAMPLE_USBD_PID,
# SAMPLE_USBD_PRODUCT, SAMPLE_USBD_VID, etc.) so that prj.conf can
# set them. The `source` path is relative to $ZEPHYR_BASE.
source "samples/subsys/usb/common/Kconfig.sample_usbd"

source "Kconfig.zephyr"
```

## sample.yaml
```
# SPDX-License-Identifier: Apache-2.0
sample:
  name: usb_cdc_echo
  description: |
    USB0 CDC-ACM echo sample for AgRV2K (`the development notes (not published here)`).

    The on-board bitstream already bridges UART0 to the CMSIS-DAP probe
    interface 1 (ttyACM0 = debug, NOT CDC-ACM). This sample exposes a
    second, virtual UART — the "zephyr,cdc-acm-uart" DLM under
    &zephyr_udc0 — which presents as a separate /dev/ttyACMx on the
    host when USB0 is plugged in. The main thread bridges USB-CDC-RX
    to USB-CDC-TX through a ring buffer (software echo). No physical
    loopback wiring is required for this sample — host ↔ device over
    the USB cable is the loopback path.
tests:
  sample.usb_cdc_echo.agm_agrv2k_407:
    build_only: true
    platform_allow:
      - agrv2k_407
    integration_platforms:
      - agrv2k_407
    tags:
      - ci_build
      - hal_ag32
      - drivers
      - usb
      - udc
      - cdc-acm
      - agrv2k
```

## prj.conf
```kconfig
# SPDX-License-Identifier: Apache-2.0
#
# USB CDC-ACM echo sample (`the development notes (not published here)`).
#
# Notes:
# - We deliberately leave CONFIG_STDOUT_CONSOLE=y. UART0 is wired to
#   the CMSIS-DAP probe (ttyACM0 on the host is the debug bridge,
#   not the CDC-ACM device), so the printk path stays usable for
#   diagnostics without colliding with the CDC-ACM data path.
# - CDC_ACM_SERIAL_INITIALIZE_AT_BOOT=n keeps the CDC-ACM DLM off
#   until main() explicitly enables rx IRQ, so the host gets a clean
#   DTR/DSR handshake before any data starts flowing.

CONFIG_USB_DEVICE_STACK_NEXT=y

CONFIG_STDOUT_CONSOLE=y
CONFIG_SERIAL=y
CONFIG_UART_LINE_CTRL=y
CONFIG_CDC_ACM_SERIAL_INITIALIZE_AT_BOOT=n

CONFIG_LOG=y
CONFIG_USBD_LOG_LEVEL_ERR=y
CONFIG_UDC_DRIVER_LOG_LEVEL_ERR=y
CONFIG_USBD_CDC_ACM_LOG_LEVEL_OFF=y

CONFIG_SAMPLE_USBD_PID=0x0001
CONFIG_SAMPLE_USBD_PRODUCT="AgRV2K USB CDC-ACM"

# === §3.21 fix: disable CONFIG_HWINFO so sample_usbd_init.c does
# not register a USBD_DUT_STRING_SERIAL_NUMBER descriptor (would point
# at index 3 with no actual string, host/VMware stalls on GET_DESCRIPTOR
# STRING/3). iSerialNumber stays at 0 in the device descriptor.
CONFIG_HWINFO=n

# === §3.21 fix: full-speed only; sample_usbd has HS descriptors by
# default but our controller is FS-only. Drop the HS support so the
# device-qualifier descriptor doesn't claim a non-functional HS alt.
CONFIG_USBD_MAX_SPEED_FULL=y

# === §3.21 fix: drop self-powered + max-power flags. CMSIS-DAP reference
# uses bmAttributes=0x80 (bus-powered, no remote wakeup) with 100 mA.
# VMware's CDC ACM passthrough reportedly stalls on devices that declare
# self-powered + 250 mA over a USB-C hub that can't provide it.
CONFIG_SAMPLE_USBD_SELF_POWERED=n
CONFIG_SAMPLE_USBD_REMOTE_WAKEUP=n
CONFIG_SAMPLE_USBD_MAX_POWER=50
```

## boards/agrv2k_407.overlay
```dts
/*
 * Copyright (c) 2026 AgRV Contributors
 * SPDX-License-Identifier: Apache-2.0
 */

/*
 * Enable the USB device controller (udc_agm → USB0) on the
 * agrv2k_407 board, and bind a virtual CDC-ACM UART to it.
 *
 * This creates a DLM child of &zephyr_udc0 named `cdc_acm_uart0`
 * that registers as a `zephyr,cdc-acm-uart` device. The CDC-ACM
 * class driver presents it on the host as /dev/ttyACMx once the
 * host enumerates USB0 (bus-powered, full-speed, single config,
 * one COMM interface + one DATA interface).
 *
 * The "uart" naming is a Zephyr convention — `cdc_acm_uart0` is
 * a virtual UART that bridges USB-CDC ↔ user code via
 * uart_fifo_{read,fill} + uart_irq_* APIs. It does NOT touch any
 * physical UART peripheral on the chip. UART0 hardware is
 * reserved for the bitstream's CMSIS-DAP debug bridge; UART1
 * hardware is not currently routed by the shipped bitstream.
 */

&zephyr_udc0 {
	cdc_acm_uart0 {
		compatible = "zephyr,cdc-acm-uart";
		label = "AgRV2K USB CDC-ACM";
	};
};
```

## src/main.c
```c
/*
 * Copyright (c) 2019 Intel Corporation
 *
 * SPDX-License-Identifier: Apache-2.0
 */

#include <sample_usbd.h>

#include <stdio.h>
#include <string.h>
#include <zephyr/device.h>
#include <zephyr/drivers/uart.h>
#include <zephyr/drivers/gpio.h>
#include <zephyr/kernel.h>
#include <zephyr/sys/ring_buffer.h>

#include <zephyr/usb/usbd.h>
#include <zephyr/logging/log.h>
LOG_MODULE_REGISTER(cdc_acm_echo, LOG_LEVEL_INF);

const struct device *const uart_dev = DEVICE_DT_GET_ONE(zephyr_cdc_acm_uart);

#define TX_BUF_SIZE 64
#define RX_BUF_SIZE 64

#define RING_BUF_SIZE 1024
uint8_t ring_buffer[RING_BUF_SIZE];

struct ring_buf ringbuf;

static bool rx_throttled;

static inline void print_baudrate(const struct device *dev)
{
	uint32_t baudrate;
	int ret;

	ret = uart_line_ctrl_get(dev, UART_LINE_CTRL_BAUD_RATE, &baudrate);
	if (ret) {
		LOG_WRN("Failed to get baudrate, ret code %d", ret);
	} else {
		LOG_INF("Baudrate %u", baudrate);
	}
}

static struct usbd_context *sample_usbd;
K_SEM_DEFINE(dtr_sem, 0, 1);

/* Temporary bring-up markers on the board LEDs (console UART bridge was
 * not delivering bytes during USB0 bring-up). Active-low LEDs.
 *   LED1 = main entered / uart_dev ready
 *   LED2 = sample_usbd_init_device() succeeded
 *   LED3 = usbd_enable() succeeded (udc_agm_enable ran)
 *   LED4 = ring buffer ready, waiting for DTR
 */
static void mark_led(uint8_t alias_idx)
{
	static const struct gpio_dt_spec marks[] = {
		GPIO_DT_SPEC_GET(DT_ALIAS(led0), gpios),
		GPIO_DT_SPEC_GET(DT_ALIAS(led1), gpios),
		GPIO_DT_SPEC_GET(DT_ALIAS(led2), gpios),
		GPIO_DT_SPEC_GET(DT_ALIAS(led3), gpios),
	};

	if (alias_idx < ARRAY_SIZE(marks) && device_is_ready(marks[alias_idx].port)) {
		gpio_pin_configure_dt(&marks[alias_idx], GPIO_OUTPUT);
		gpio_pin_set_dt(&marks[alias_idx], 1);
	}
}

static void sample_msg_cb(struct usbd_context *const ctx, const struct usbd_msg *msg)
{
	LOG_INF("USBD message: %s", usbd_msg_type_string(msg->type));

	if (usbd_can_detect_vbus(ctx)) {
		if (msg->type == USBD_MSG_VBUS_READY) {
			if (usbd_enable(ctx)) {
				LOG_ERR("Failed to enable device support");
			}
		}

		if (msg->type == USBD_MSG_VBUS_REMOVED) {
			if (usbd_disable(ctx)) {
				LOG_ERR("Failed to disable device support");
			}
		}
	}

	if (msg->type == USBD_MSG_CDC_ACM_CONTROL_LINE_STATE) {
		uint32_t dtr = 0U;

		uart_line_ctrl_get(msg->dev, UART_LINE_CTRL_DTR, &dtr);
		if (dtr) {
			k_sem_give(&dtr_sem);
		}
	}

	if (msg->type == USBD_MSG_CDC_ACM_LINE_CODING) {
		print_baudrate(msg->dev);
	}
}

static int enable_usb_device_next(void)
{
	int err;

	sample_usbd = sample_usbd_init_device(sample_msg_cb);
	if (sample_usbd == NULL) {
		LOG_ERR("Failed to initialize USB device");
		return -ENODEV;
	}
	mark_led(1);

	if (!usbd_can_detect_vbus(sample_usbd)) {
		err = usbd_enable(sample_usbd);
		if (err) {
			LOG_ERR("Failed to enable device support");
			return err;
		}
	}

	LOG_INF("USB device support enabled");
	mark_led(2);

	return 0;
}

static void interrupt_handler(const struct device *dev, void *user_data)
{
	ARG_UNUSED(user_data);

	int space;

	while (true) {
		uart_irq_update(dev);

		if (uart_irq_is_pending(dev) <= 0) {
			break;
		}

		if (!rx_throttled && uart_irq_rx_ready(dev)) {
			int recv_len, rb_len;
			uint8_t buffer[RX_BUF_SIZE];
			size_t len = MIN(ring_buf_space_get(&ringbuf),
					 sizeof(buffer));

			if (len == 0) {
				/* Throttle because ring buffer is full */
				uart_irq_rx_disable(dev);
				rx_throttled = true;
				continue;
			}

			recv_len = uart_fifo_read(dev, buffer, len);
			if (recv_len < 0) {
				LOG_ERR("Failed to read UART FIFO");
				recv_len = 0;
			};

			rb_len = ring_buf_put(&ringbuf, buffer, recv_len);
			if (rb_len < recv_len) {
				LOG_ERR("Drop %u bytes", recv_len - rb_len);
			}

			LOG_DBG("tty fifo -> ringbuf %d bytes", rb_len);
			if (rb_len) {
				uart_irq_tx_enable(dev);
			}
		}

		space = uart_irq_tx_ready(dev);
		if (space > 0) {
			uint8_t buffer[TX_BUF_SIZE];
			int rb_len, send_len;

			rb_len = ring_buf_get(&ringbuf, buffer, MIN(space, sizeof(buffer)));
			if (!rb_len) {
				LOG_DBG("Ring buffer empty, disable TX IRQ");
				uart_irq_tx_disable(dev);
				continue;
			}

			if (rx_throttled) {
				uart_irq_rx_enable(dev);
				rx_throttled = false;
			}

			send_len = uart_fifo_fill(dev, buffer, rb_len);
			if (send_len < rb_len) {
				LOG_ERR("Drop %d bytes", rb_len - send_len);
			}

			LOG_DBG("ringbuf -> tty fifo %d bytes", send_len);
		}
	}
}

int main(void)
{
	int ret;

	if (!device_is_ready(uart_dev)) {
		LOG_ERR("CDC ACM device not ready");
		return 0;
	}
	mark_led(0);

	ret = enable_usb_device_next();
	if (ret != 0) {
		LOG_ERR("Failed to enable USB device support");
		return 0;
	}
	ring_buf_init(&ringbuf, sizeof(ring_buffer), ring_buffer);
	mark_led(3);

	LOG_INF("Wait for DTR");
	k_sem_take(&dtr_sem, K_FOREVER);
	LOG_INF("DTR set");

	/* They are optional, we use them to test the interrupt endpoint */
	ret = uart_line_ctrl_set(uart_dev, UART_LINE_CTRL_DCD, 1);
	if (ret) {
		LOG_WRN("Failed to set DCD, ret code %d", ret);
	}

	ret = uart_line_ctrl_set(uart_dev, UART_LINE_CTRL_DSR, 1);
	if (ret) {
		LOG_WRN("Failed to set DSR, ret code %d", ret);
	}

	/* Wait 100ms for the host to do all settings */
	k_msleep(100);

	uart_irq_callback_set(uart_dev, interrupt_handler);
	/* Enable rx interrupts */
	uart_irq_rx_enable(uart_dev);

	return 0;
}
```
