## CMakeLists.txt
```
# SPDX-License-Identifier: Apache-2.0
cmake_minimum_required(VERSION 3.20.0)

find_package(Zephyr REQUIRED HINTS $ENV{ZEPHYR_BASE})
project(user_ip)

# Sample-local Kconfig: the single toggle above (see its help).
set(KCONFIG_ROOT ${CMAKE_CURRENT_SOURCE_DIR}/Kconfig)

target_sources(app PRIVATE src/main.c)
```

## Kconfig
```
# SPDX-License-Identifier: Apache-2.0

mainmenu "user_ip"

# This sample sets its own Kconfig root (see CMakeLists.txt), so it has to pull
# the Zephyr tree in itself -- without it, prj.conf's SERIAL/PRINTK are
# undefined symbols.
source "Kconfig.zephyr"

config APP_USER_IP_TOUCH_BUS
	bool "Touch the register block at runtime"
	default n
	help
	  Read the ID register through the cpld_agm API, exercise the block
	  guard, and print RESULT: OK/FAIL for the dev board. Off by default: this
	  bus has no timeout -- an offset the bitstream does not decode stalls
	  the CPU with no fault and no console output -- so the sample only
	  touches it when the flashed bitstream really has the block (the
	  vendor echo/analog_ip examples do).
```

## sample.yaml
```
# SPDX-License-Identifier: Apache-2.0
sample:
  name: user_ip
  description: |
    Reach a piece of user logic in the AgRV2K fabric from Zephyr, splitting
    the description where it belongs: the *window* comes from devicetree
    (agm,agrv2k-cpld, which the driver range-checks), the *register map* from
    a header next to the RTL (src/user_ip_regs.h) -- the same board with
    another bitstream has different registers, and devicetree cannot express
    bitfields. The build asserts the block fits the window and every register
    fits the block; the runtime half prints that map and touches the bus only
    when CONFIG_APP_USER_IP_TOUCH_BUS is on (an unmapped offset stalls the CPU
    instead of faulting).
tests:
  sample.user_ip.agm_agrv2k_407:
    build_only: true
    platform_allow:
      - agrv2k_407
    integration_platforms:
      - agrv2k_407
    tags:
      - ci_build
      - hal_ag32
  # Same devicetree, with the bus access enabled: builds the read path the
  # application uses on a board whose bitstream really has the IP.
  sample.user_ip.touch_bus.agm_agrv2k_407:
    build_only: true
    extra_configs:
      - CONFIG_APP_USER_IP_TOUCH_BUS=y
    platform_allow:
      - agrv2k_407
    tags:
      - ci_build
      - hal_ag32
```

## prj.conf
```kconfig
# SPDX-License-Identifier: Apache-2.0
CONFIG_SERIAL=y
CONFIG_UART_CONSOLE=y
CONFIG_PRINTK=y
CONFIG_STDOUT_CONSOLE=y

# The driver that owns the window this sample's slice lives in.
CONFIG_CPLD_AGM=y

# Reading a register block the bitstream does not decode stalls the CPU (the
# AHB handshake never completes), so the default build only resolves the
# devicetree and prints it. Turn this on for a board that has the IP.
# CONFIG_APP_USER_IP_TOUCH_BUS=y
```

## boards/agrv2k_407.overlay
```dts
/* SPDX-License-Identifier: Apache-2.0 */
/*
 * user_ip — the only thing this sample needs from the board is the fabric
 * window itself.
 *
 * cpld0 (0x60000000 + 0x8000 in the SoC dtsi) is disabled by default because
 * a bitstream without a `mem_ahb` slave stalls the CPU on the first access;
 * enabling it is what samples/cpld_reg does too. The *register map* of the
 * user logic is deliberately not here: it lives in src/user_ip_regs.h, next
 * to (or generated from) the RTL, because it changes with the bitstream and
 * devicetree cannot express bitfields (see that header's comment).
 *
 * A pin the fabric drives as an interrupt *is* a board fact and would belong
 * here, on the GPIO node the MCU sees it on -- the fabric has no line to the
 * PLIC, so CPLD -> pin -> GPIO bank is the only path today:
 *
 *	&gpio6 {
 *		status = "okay";
 *	};
 *
 * with the application installing a handler on that line (gpio_pin_interrupt
 * _configure + a callback).
 */

&cpld0 {
	status = "okay";
};
```

## src/main.c
```c
/*
 * Copyright (c) 2026 AgRV Contributors
 * SPDX-License-Identifier: Apache-2.0
 *
 * user_ip — reach a piece of user logic in the fabric from Zephyr.
 *
 * The split this sample demonstrates (docs/CUSTOM-IP.md §1.1 and §2.1):
 *
 *   devicetree: the *window* (agm,agrv2k-cpld -- an SoC address range the
 *               driver owns and range-checks), and, when there is one, the pin
 *               the fabric drives as an interrupt;
 *   macros:     the register map and the block's offset/size inside that
 *               window (src/user_ip_regs.h), because those belong to the
 *               bitstream and to the RTL rather than to the board: the same
 *               board with another bitstream has different registers, and a
 *               header is something the RTL can share or generate.
 *
 * What still has to be enforced is that the description *fits*: the block
 * inside the window (BUILD_ASSERT against DT_REG_SIZE(cpld0)) and every
 * register inside the block. On this bus a mismatch stalls the CPU instead of
 * faulting, so it has to fail the build.
 *
 * If the design ever grows several instances of the block, or a driver that
 * wants to bind and be enumerated (DEVICE_DT_GET / device_is_ready), that is
 * when a devicetree node for the *instance* starts paying for itself -- add
 * the binding then and keep the register map here.
 */

#include <zephyr/device.h>
#include <zephyr/devicetree.h>
#include <zephyr/drivers/misc/cpld_agm.h>
#include <zephyr/kernel.h>
#include <zephyr/sys/printk.h>

#include "user_ip_regs.h"

#define WINDOW_NODE DT_NODELABEL(cpld0)

#if !DT_NODE_HAS_STATUS(WINDOW_NODE, okay)
#error "cpld0 is disabled: build with a board overlay that enables the window"
#endif

#define WINDOW_SIZE DT_REG_SIZE(WINDOW_NODE)

/* What can be checked without the RTL, checked where a mistake is cheap. */
BUILD_ASSERT(USER_IP_OFFSET % 4U == 0U,
	     "the block has to start on a 32-bit register boundary");
BUILD_ASSERT(USER_IP_SIZE % 4U == 0U,
	     "the block has to be a whole number of 32-bit registers");
BUILD_ASSERT(USER_IP_OFFSET + USER_IP_SIZE <= WINDOW_SIZE,
	     "the user IP block does not fit the fabric window: widen the "
	     "window's reg, or move the block in the RTL and in user_ip_regs.h "
	     "-- an access outside the window stalls the CPU");
BUILD_ASSERT(USER_IP_REG_OK(USER_IP_REG_ID) &&
		     USER_IP_REG_OK(USER_IP_REG_CTRL) &&
		     USER_IP_REG_OK(USER_IP_REG_STATUS) &&
		     USER_IP_REG_OK(USER_IP_REG_COUNTER),
	     "a register in user_ip_regs.h is past the end of the block");

#if defined(CONFIG_APP_USER_IP_TOUCH_BUS)
/* The application's half of the guard: the driver checks the *window*, this
 * checks the *block*, so a bad offset never reaches the bus at all. */
static int user_ip_read(const struct device *window, uint32_t reg, uint32_t *val)
{
	if (!USER_IP_REG_OK(reg)) {
		printk("user_ip: +0x%02x is outside the block (size 0x%x)\n", reg,
		       USER_IP_SIZE);
		return -EINVAL;
	}

	return agm_cpld_read32(window, USER_IP_OFFSET + reg, val);
}
#endif

int main(void)
{
	const struct device *window = DEVICE_DT_GET(WINDOW_NODE);
	uintptr_t base = 0U;
	size_t size = 0U;

	printk("=== user_ip: user logic in the fabric window ===\n");
	printk("window   : %s @0x%08x+0x%x\n", window->name,
	       (uint32_t)DT_REG_ADDR(WINDOW_NODE), WINDOW_SIZE);
	printk("block    : window+0x%x, 0x%x bytes, %u register(s)\n",
	       USER_IP_OFFSET, USER_IP_SIZE, USER_IP_REG_COUNT);
	printk("  +0x%02x  ID      (expect 0x%08x)\n", USER_IP_REG_ID,
	       (uint32_t)USER_IP_ID_VALUE);
	printk("  +0x%02x  CTRL    (ENABLE|IRQEN|CLR)\n", USER_IP_REG_CTRL);
	printk("  +0x%02x  STATUS  (READY|IRQ)\n", USER_IP_REG_STATUS);
	printk("  +0x%02x  COUNTER\n", USER_IP_REG_COUNTER);

	if (!device_is_ready(window)) {
		printk("user_ip: RESULT: FAIL -- the window driver is not ready\n");
		return 0;
	}

	if (agm_cpld_get_base(window, &base) == 0 &&
	    agm_cpld_get_size(window, &size) == 0) {
		printk("driver   : base 0x%08x size 0x%x\n", (uint32_t)base,
		       (uint32_t)size);
	}

#if defined(CONFIG_APP_USER_IP_TOUCH_BUS)
	/* Only on a board whose bitstream really decodes this block: the bus
	 * has no timeout, so an unmapped offset hangs rather than faulting. */
	uint32_t id = 0U;

	if (user_ip_read(window, USER_IP_REG_ID, &id) != 0) {
		printk("user_ip: RESULT: FAIL -- reading the ID register\n");
		return 0;
	}
	printk("read     : ID = 0x%08x%s\n", id,
	       (id == (uint32_t)USER_IP_ID_VALUE) ? "" : "  (unexpected)");

	if (user_ip_read(window, USER_IP_SIZE, &id) == 0) {
		printk("user_ip: RESULT: FAIL -- the block guard let a read past "
		       "the block through\n");
		return 0;
	}
#else
	printk("bus      : not touched (CONFIG_APP_USER_IP_TOUCH_BUS=n); the "
	       "declaration above is the whole test\n");
#endif

	printk("user_ip: RESULT: OK -- window+0x%x, block 0x%x\n", USER_IP_OFFSET,
	       USER_IP_SIZE);
	return 0;
}
```

## src/user_ip_regs.h
```c
/*
 * Copyright (c) 2026 AgRV Contributors
 * SPDX-License-Identifier: Apache-2.0
 *
 * The register map of one piece of user logic, as macros.
 *
 * Why macros and not devicetree: this map is a property of the *fabric*, not
 * of the board -- the same board with a different bitstream has different
 * registers -- and it is written in the RTL, which lives in the Quartus flow
 * rather than in this build. Keeping it here (a header the RTL and the
 * firmware can share, or that a generator can emit from the RTL) means one
 * source instead of two that drift; devicetree cannot express bitfields
 * anyway. What *is* devicetree's business is the window this block lives in
 * (agm,agrv2k-cpld: an SoC-level address range the driver range-checks) and
 * the pin a fabric interrupt drives -- those are board/SoC facts.
 *
 * Keep this in step with the Verilog. The build checks what can be checked
 * without the RTL: that the block fits inside the window (main.c's
 * BUILD_ASSERT) and that every register is inside the block (here).
 */

#ifndef SAMPLES_USER_IP_REGS_H_
#define SAMPLES_USER_IP_REGS_H_

#include <stdint.h>

#include <zephyr/sys/util.h>

/*
 * Where the block sits inside the fabric window, and how big it is. The
 * vendor examples put their wrappers at 0x0000 / 0x1000 / 0x2000 (ADC0/1/2)
 * and SPI0 at 0x6000; 0x1000 is the one this sample claims.
 */
#define USER_IP_OFFSET 0x1000U
#define USER_IP_SIZE   0x100U

/* Registers (byte offsets from the block start). */
#define USER_IP_REG_ID      0x00U /* RO: magic/version, see below */
#define USER_IP_REG_CTRL    0x04U /* RW */
#define USER_IP_REG_STATUS  0x08U /* RO */
#define USER_IP_REG_COUNTER 0x0cU /* RO: free-running */

#define USER_IP_REG_COUNT   4U

/* USER_IP_REG_ID: the RTL's idea of its own identity, so a firmware/bitstream
 * mismatch is visible on the console instead of showing up as garbage reads. */
#define USER_IP_ID_MAGIC   0x5550U /* "UP" (user IP) */
#define USER_IP_ID_VERSION 0x0001U
#define USER_IP_ID_VALUE \
	(((uint32_t)USER_IP_ID_MAGIC << 16) | (uint32_t)USER_IP_ID_VERSION)

/* USER_IP_REG_CTRL bits. */
#define USER_IP_CTRL_ENABLE BIT(0)
#define USER_IP_CTRL_IRQEN  BIT(1)
#define USER_IP_CTRL_CLR    BIT(2) /* write 1 to clear */

/* USER_IP_REG_STATUS bits. */
#define USER_IP_STATUS_READY BIT(0)
#define USER_IP_STATUS_IRQ   BIT(1)

/* The build-time half of "one source of truth": every register has to be a
 * 32-bit access inside the block. */
#define USER_IP_REG_OK(off) ((off) + 4U <= USER_IP_SIZE)

#endif /* SAMPLES_USER_IP_REGS_H_ */
```
