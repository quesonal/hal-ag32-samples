## CMakeLists.txt
```
# SPDX-License-Identifier: Apache-2.0

cmake_minimum_required(VERSION 3.28.0)

find_package(Zephyr REQUIRED HINTS $ENV{ZEPHYR_BASE})
project(i2c_scan LANGUAGES C)

target_sources(app PRIVATE src/main.c)
```

## sample.yaml
```
# SPDX-License-Identifier: Apache-2.0
sample:
  name: i2c_scan
  description: I2C0 bus scan on agrv2k_407 (AGM OpenCores I2C driver)
tests:
  sample.i2c_scan.agm_agrv2k_407:
    build_only: true
    platform_allow:
      - agrv2k_407
    integration_platforms:
      - agrv2k_407
    tags:
      - ci_build
      - hal_ag32
```

## prj.conf
```kconfig
# SPDX-License-Identifier: Apache-2.0
CONFIG_SERIAL=y
CONFIG_UART_CONSOLE=y
CONFIG_PRINTK=y
CONFIG_STDOUT_CONSOLE=y
CONFIG_XIP=y

CONFIG_I2C=y
```

## boards/agrv2k_407.overlay
```dts
/* SPDX-License-Identifier: Apache-2.0 */
/*
 * Enable I2C0 on agrv2k_407.
 *
 * The FPGA bitstream routes I2C0 SDA -> PIN_36 / SCL -> PIN_35
 * (board.ve). The i2c_agm driver enables the APB clocks and sets the
 * GPIO3 AFSEL bits itself at init.
 */
&i2c0 {
	status = "okay";
};
```

## src/main.c
```c
/*
 * Copyright (c) 2026 AgRV Contributors
 * SPDX-License-Identifier: Apache-2.0
 *
 * i2c_scan — smoke test for the AgRV2K I2C0 controller driver.
 *
 * Scans the standard 7-bit address range and reports what ACKs.
 * The reference wiring is a BH1750 (GY-302) on PIN_35/36, which both
 * supplies the bus pull-ups and answers at 0x23.
 *
 * NOTE (measured 2026-09-10): with NOTHING attached every probe
 * returns -ETIMEDOUT, not -ENXIO -- the pins have no pull-ups, SCL is
 * never released high and the core's TIP bit never clears. So an
 * all-(-ETIMEDOUT) scan means "no slave / no pull-ups", not a broken
 * controller; -ENXIO is only reachable on a pulled-up bus.
 */

#include <errno.h>
#include <stdio.h>

#include <zephyr/device.h>
#include <zephyr/drivers/i2c.h>
#include <zephyr/kernel.h>

#define I2C0 DT_NODELABEL(i2c0)

int main(void)
{
	const struct device *i2c = DEVICE_DT_GET(I2C0);
	uint8_t dummy = 0;
	uint32_t found = 0;
	uint32_t errors = 0;

	printk("i2c_scan: I2C0 = %s\n", i2c->name);

	if (!device_is_ready(i2c)) {
		printk("i2c_scan: I2C0 not ready\n");
		return 0;
	}

	printk("i2c_scan: scanning 0x08..0x77...\n");
	for (uint16_t addr = 0x08U; addr <= 0x77U; addr++) {
		struct i2c_msg msg = {
			.buf = &dummy,
			.len = 1U,
			.flags = I2C_MSG_WRITE | I2C_MSG_STOP,
		};
		int rc = i2c_transfer(i2c, &msg, 1U, addr);

		if (rc == 0) {
			printk("i2c_scan:   found device at 0x%02x\n", addr);
			found++;
		} else if (rc != -ENXIO) {
			/* -ENXIO == address NACK (needs a pulled-up bus);
			 * anything else is a real error. */
			printk("i2c_scan:   0x%02x -> err %d\n", addr, rc);
			errors++;
		}
	}
	printk("i2c_scan: done: %u found, %u unexpected errors\n",
	       found, errors);
	if (errors == 0U) {
		printk("i2c_scan: PASS (controller alive; empty bus as expected)\n");
	} else {
		printk("i2c_scan: FAIL (check BH1750 / pull-ups on PIN_35/36)\n");
	}

	while (1) {
		k_msleep(1000);
	}
}
```
