## CMakeLists.txt
```
# SPDX-License-Identifier: Apache-2.0
cmake_minimum_required(VERSION 3.28.0)
find_package(Zephyr REQUIRED HINTS $ENV{ZEPHYR_BASE})
project(lan8720_iperf LANGUAGES C)
target_sources(app PRIVATE src/main.c)
```

## Kconfig
```
# SPDX-License-Identifier: Apache-2.0
#
# Sample-local Kconfig for the iperf2 TCP throughput test.
# Network-stack options (zperf, ETH drivers, buffers, IP) live in
# prj.conf; this file only owns the knobs the user is expected to
# touch when running the test.
#
# `source "Kconfig.zephyr"` pulls in all the standard networking /
# driver / OS symbols so that prj.conf's CONFIG_NET_* / CONFIG_NET_ZPERF_*
# references resolve at parse time. Without this line, every symbol
# in prj.conf becomes an "undefined symbol" warning and Kconfig
# aborts. (Same trick as samples/fcb_hotswap/Kconfig.)

source "Kconfig.zephyr"

menuconfig LAN8720_IPERF
	bool "lan8720_iperf sample"
	default y
	help
	  Enable the iperf2 TCP throughput client sample on the
	  AgRV2K on-die MAC0 + LAN8720 RMII PHY.

if LAN8720_IPERF

config LAN8720_IPERF_SERVER_IP
	string "iperf2 server IPv4 address"
	default "192.168.15.100"
	help
	  IPv4 address of the iperf2 server (PC). Must be in the same
	  /24 subnet as the board's CONFIG_NET_CONFIG_MY_IPV4_ADDR.

config LAN8720_IPERF_SERVER_PORT
	int "iperf2 server TCP port"
	default 5001
	range 1 65535
	help
	  TCP port the iperf2 server listens on. iperf2 default is 5001.

choice LAN8720_IPERF_PROTO
	prompt "Upload protocol"
	default LAN8720_IPERF_PROTO_TCP
	help
	  Both variants talk to iperf2 on the PC: TCP to `iperf -s`, UDP to
	  `iperf -s -u` (same default port 5001).

config LAN8720_IPERF_PROTO_TCP
	bool "TCP (iperf -s)"
	help
	  ACK-clocked bulk transfer. Measures end-to-end TCP goodput; the
	  rate is set by the round trip and window, not by us.

config LAN8720_IPERF_PROTO_UDP
	bool "UDP (iperf -s -u)"
	help
	  Rate-paced UDP with no ACK clocking, so the sender is limited only
	  by the driver, the stack and the wire. This is the variant that
	  answers "how fast can the MAC actually push data". The iperf2
	  server sends back a report (received bytes, loss, jitter) which
	  zperf decodes into the result.

config LAN8720_IPERF_PROTO_RAW
	bool "RAW L2 -- dev board-only MAC ceiling probe (no iperf server)"
	select NET_ZPERF_RAW_TX
	select NET_SOCKETS_PACKET
	help
	  Build the frame by hand and hand it straight to the driver
	  (NET_AF_PACKET/NET_SOCK_RAW), with no IP, UDP or TCP above it.
	  NOT iperf-compatible: there is no server side and no report.

	  This exists to answer one question -- is the iperf2 number
	  limited by the board or by the upstream network stack? Capture on
	  the PC with `tcpdump -i <if> ether proto <ethertype>`; the host
	  kernel drops the frames because the ethertype is unassigned.

endchoice

config LAN8720_IPERF_RAW_ETHERTYPE
	hex "RAW mode ethertype"
	depends on LAN8720_IPERF_PROTO_RAW
	default 0x88b5
	help
	  0x88B5 is "Local Experimental Ethertype 1" -- nothing on the host
	  claims it, so the frames are counted by tcpdump and then dropped.

config LAN8720_IPERF_RAW_RATE_KBPS
	int "RAW target rate (kbit/s)"
	depends on LAN8720_IPERF_PROTO_RAW
	default 1000000
	range 1 10000000
	help
	  Same units as the UDP knob (x1024 bit/s) and, like it, must be
	  non-zero. The default is far above the 100 Mb PHY, so the pacing
	  is a no-op and the run is a pure max-throughput probe.

config LAN8720_IPERF_RAW_PACKET_SIZE
	int "RAW frame size (bytes, header + payload)"
	depends on LAN8720_IPERF_PROTO_RAW
	default 1502
	range 60 1514
	help
	  Total on-the-wire frame size: 14 B Ethernet header + payload,
	  without FCS. The default 1502 matches what the UDP mode puts on
	  the wire (1460 B payload + 40 B zperf header + 8 UDP + 20 IP +
	  14 Ethernet), so the two modes can be compared directly.

config LAN8720_IPERF_UDP_RATE_KBPS
	int "UDP target rate (kbit/s)"
	depends on LAN8720_IPERF_PROTO_UDP
	default 100000
	range 1 1000000
	help
	  Target send rate in zperf/iperf2 units (x1024 bit/s). The uploader
	  paces packets to this rate. The default 100000 = 102.4 Mbit/s is
	  deliberately above the 100 Mb PHY, so the pacing never becomes the
	  limit and the run shows what the board can really push. Must be
	  non-zero: zperf divides by it.

config LAN8720_IPERF_DURATION_MS
	int "Upload duration (ms)"
	default 10000
	range 100 600000
	help
	  How long the client streams data to the server. 10 s is
	  typical; longer gives a more stable throughput number.

config LAN8720_IPERF_PACKET_SIZE
	int "TCP segment size (bytes)"
	default 1460
	range 64 9000
	help
	  Payload size per TCP segment. 1460 = MTU 1500 - 20 IP - 20 TCP;
	  avoids IP fragmentation and maximises throughput.

	  Must be <= CONFIG_NET_ZPERF_MAX_PACKET_SIZE (1460 in this
	  sample's prj.conf), otherwise zperf silently clamps it at
	  runtime. main.c has a BUILD_ASSERT so a mismatched pair fails
	  the build instead.

config LAN8720_IPERF_MIN_MBITPS
	int "Minimum throughput for PASS (Mbit/s)"
	default 1
	range 0 1000
	help
	  If measured throughput falls below this, the sample logs FAIL.
	  Set to 0 to disable the threshold check.

endif # LAN8720_IPERF
```

## sample.yaml
```
# SPDX-License-Identifier: Apache-2.0
sample:
  name: lan8720_iperf
  description: |
    iperf2-compatible TCP throughput test client.

    Streams TCP data to an external iperf2 server (`iperf -s` on the
    PC) for CONFIG_LAN8720_IPERF_DURATION_MS and reports throughput
    over UART. Uses the upstream zperf library
    (CONFIG_NET_ZPERF, server/shell disabled) for the upload path,
    which gives a tested iperf2-compatible wire format.

    Sequence: PHY link up -> iface operational -> ICMP pre-flight at
    the server address (separates "board cannot reach the PC" from
    "no iperf2 server listening") -> one zperf TCP upload -> bytes /
    packets / send errors / Mbit/s -> PASS/FAIL against
    CONFIG_LAN8720_IPERF_MIN_MBITPS.

    Re-uses the same dev bitstream, pin list and 100 MHz clock as
    samples/lan8720_link (eth0 / mdio0 / phy0 nodes). Adds a static
    IPv4 address via CONFIG_NET_CONFIG_* and a server endpoint via
    LAN8720_IPERF_* Kconfig (see Kconfig in this sample).

    PC-side setup and the run order (start `iperf -s` BEFORE the
    board boots -- the upload begins a few seconds after reset) are
    in README.md, together with the buffer tuning knobs and the
    symptom table for reading a low number.

    PC must run iperf2 (NOT iperf3 -- different protocol). On Debian
    and Ubuntu `iperf -s` gives 2.x; on Fedora / Alpine / macOS
    Homebrew the `iperf` binary is iperf3, install the iperf2 package
    or build from source.

    Expect the iperf2 server to also print a cosmetic
    "LAST PACKET NOT RECEIVED!!!" line -- zperf does not send the
    28-byte iperf2 TCP control header, and modern iperf2 servers
    tolerate that and still report throughput.

    Build-only verified so far; the first dev board run should record its
    numbers in the port record (ethernet) §3.28.1.
tests:
  sample.lan8720_iperf.agm_agrv2k_407:
    build_only: true
    platform_allow:
      - agrv2k_407
    integration_platforms:
      - agrv2k_407
    tags:
      - ci_build
      - hal_ag32
```

## prj.conf
```kconfig
# SPDX-License-Identifier: Apache-2.0

# --- Console / XIP ---
CONFIG_SERIAL=y
CONFIG_UART_CONSOLE=y
CONFIG_PRINTK=y
CONFIG_STDOUT_CONSOLE=y
CONFIG_XIP=y

# --- Networking: Zephyr net stack + L2 Ethernet, IPv4 only (no IPv6:
#     saves code space and DHCPv6 init time) ---
CONFIG_NETWORKING=y
CONFIG_NET_L2_ETHERNET=y
CONFIG_NET_IPV4=y
CONFIG_NET_IPV6=n
CONFIG_NET_TCP=y
# UDP is needed by the LAN8720_IPERF_PROTO_UDP variant; it is cheap
# enough to leave on for the TCP variant as well.
CONFIG_NET_UDP=y
CONFIG_NET_DHCPV4=n
CONFIG_ETH_DRIVER=y
CONFIG_NET_STATISTICS=y
CONFIG_NET_STATISTICS_ETHERNET=y

# --- Static IPv4 for the board (override at build time with
#     -DCONFIG_NET_CONFIG_MY_IPV4_ADDR=...). The server address is the
#     LAN8720_IPERF_SERVER_IP Kconfig in this sample. ---
CONFIG_NET_CONFIG_SETTINGS=y
CONFIG_NET_CONFIG_AUTO_INIT=y
CONFIG_NET_CONFIG_NEED_IPV4=y
CONFIG_NET_CONFIG_NEED_IPV6=n
CONFIG_NET_CONFIG_MY_IPV4_ADDR="192.168.15.1"
CONFIG_NET_CONFIG_MY_IPV4_NETMASK="255.255.255.0"
CONFIG_NET_CONFIG_MY_IPV4_GW="192.168.15.254"

# --- Buffer budget: this is the sample's main tuning knob.
#
#     NET_BUF_DATA_SIZE is raised from the default 128 to the Ethernet
#     MTU so one TCP segment (1460 B payload + 14/20/20 headers =
#     1514 B) fits in a single net_buf instead of being split across a
#     dozen 128 B fragments. That fragment churn is pure CPU, and on
#     this part the CPU (100 MHz, no cache, XIP flash) is the
#     throughput bottleneck long before the 100 Mb wire is.
#
#     NET_BUF_TX_COUNT then sets how much data can be in flight: at
#     1460 B segments per buffer, N buffers ~= N * 1460 B of send
#     window (~12 KB at 8, ~23 KB at 16). If throughput plateaus and
#     zperf logs "network buffer allocation errors", raise it -- zperf
#     also reports that count back as nb_packets_errors.
#
#     RAM: the pools take ~38 KB of the 128 KB on-chip RAM; check with
#     `west build -d <dir> -t ram_report`. ---
CONFIG_NET_BUF_DATA_SIZE=1536
CONFIG_NET_PKT_RX_COUNT=8
CONFIG_NET_PKT_TX_COUNT=16
CONFIG_NET_BUF_RX_COUNT=8
CONFIG_NET_BUF_TX_COUNT=16
CONFIG_NET_MAX_CONTEXTS=5
CONFIG_HEAP_MEM_POOL_SIZE=8192

# TX descriptors set the in-flight window for the MAC: eth_agm_send()
# no longer waits for each frame to complete, so the number of
# descriptors is what bounds how many frames can be queued behind the
# one being transmitted. 4 was enough for a single-frame-at-a-time
# driver; 8 gives the UDP flood somewhere to go.
CONFIG_ETH_AGM_TX_DESCRIPTORS=8

# zperf_tcp_upload() blocks the calling thread and runs the socket +
# net_buf paths on that thread's stack; the 1 KB default main stack is
# not enough.
CONFIG_MAIN_STACK_SIZE=4096

# --- Driver: same as lan8720_link, keep the symbols in sync ---
CONFIG_ETH_AGM=y
CONFIG_MDIO_AGM=y
CONFIG_PHY_AGM_LAN8720=y

# --- Entropy for the TCP stack ---
CONFIG_ENTROPY_GENERATOR=y
CONFIG_TEST_RANDOM_GENERATOR=y

# --- zperf: client side only. Server off (we never accept connections)
#     and shell off (unused, ~30 KB ROM). MAX_PACKET_SIZE must be >=
#     this sample's LAN8720_IPERF_PACKET_SIZE -- main.c has a
#     BUILD_ASSERT so a mis-set pair fails the build instead of being
#     silently clamped. ---
CONFIG_NET_ZPERF=y
CONFIG_NET_ZPERF_SERVER=n
# 1514 so the dev board-only RAW mode can push a full-size frame (14 B
# Ethernet header + 1500 B); the UDP/TCP modes only need 1460 and
# assert that their own headers still fit the MTU.
CONFIG_NET_ZPERF_MAX_PACKET_SIZE=1514

# --- LOG: 3 = INFO (this sample's LOG_INF lines plus zperf's own
#     NET_WARN/NET_ERR), immediate mode so the PASS/FAIL line is on the
#     wire before the console drains.
#
#     Do NOT raise this to 4 (= DEBUG): every module that does not
#     declare its own level then logs at DBG, and the net stack's DBG
#     output costs ~425 ms per packet at 115200 with LOG_MODE_IMMEDIATE.
#     That would be measuring the console, not the link -- see
#     the port record (ethernet) §3.28.6 (same firmware measured
#     392 ms vs 1.7 ms round trip purely on this setting). ---
CONFIG_LOG=y
CONFIG_LOG_DEFAULT_LEVEL=3
CONFIG_LOG_MODE_IMMEDIATE=y

# --- Throughput: build for speed, not size. ---
CONFIG_SPEED_OPTIMIZATIONS=y
```

## boards/agrv2k_407.overlay
```dts
/*  SPDX-License-Identifier: Apache-2.0 */
/*
 * lan8720_iperf -- board overlay for the iperf2 TCP throughput test.
 * Same dev bitstream as samples/lan8720_link — the canonical
 *   <your canonical bitstream>
 *   200 MHz SYSCLK / 100 MHz HCLK (board defaults), MAC pins routed per
 *   example_board_routed.v (PIN_43..47 + 57..59).
 *
 * Three things land here:
 *
 *   1. Replace the shared pin list with the MAC0 RMII pins.
 *      PHY_RSTB / MAC0_PHY_INTB are NOT routed in this bitstream --
 *      PHY reset is MII_BMCR soft reset only, link is monitored via
 *      BMSR polling (same as lan8720_link).
 *
 *   2. Enable the eth0 (MAC0) + mdio0 + phy0 nodes.
 *
 *   3. Override the 200 MHz board default to 100 MHz (matches the
 *      dev bitstream). Without this the UART baud and tick rate are
 *      wrong (silent console at the configured 115200 8N1).
 *
 * IP addresses come from prj.conf (CONFIG_NET_CONFIG_*); not set
 * here so the user can override the board IP at build time with
 * -DCONFIG_NET_CONFIG_MY_IPV4_ADDR=... without editing the overlay.
 */

&agrv2k_pins {
	mcu-functions =
		/* MAC0 RMII pins -- same pin list as lan8720_link */
		"MAC0_RXD0",
		"MAC0_RXD1",
		"MAC0_TXD0",
		"MAC0_TXD1",
		"MAC0_TX_EN",
		"MAC0_CRS",
		"MAC0_TX_CLK",
		"MAC0_MDC",
		"MAC0_MDIO",

		/* The console UART0 is routed by this bitstream as well (the
		 * banner comes out of it), so it belongs in this list: the list
		 * describes what the *bitstream* routes, not just what this
		 * sample uses. tools/check_pinctrl.py compares it against the
		 * netlist. */
		"UART0_UARTRXD",
		"UART0_UARTTXD";
	mcu-pins =
		<47>, <46>,
		<44>, <43>,
		<45>,
		<56>,
		<57>,
		<58>, <59>,

		/* UART0 console: PIN_69 = RX, PIN_68 = TX */
		<69>, <68>;
};

&eth0 {
	status = "okay";
};

&mdio0 {
	status = "okay";
};

&phy0 {
	status = "okay";
};

/* Clock: the dev bitstream is now
 *   <your canonical bitstream>
 * (VE: SYSCLK 200 / BUSCLK 100 / HSECLK 8), which is exactly what the
 * agrv2k_407 board defaults describe (AGM_SYSCLK_HZ 200 MHz,
 * AGM_FLASH_MAX_HZ 100 MHz), so there is nothing to override here.
 *
 * The older 100 MHz bitstream needs the opposite: build with
 *   -- -DEXTRA_DTC_OVERLAY_FILE=/tmp/agm100.overlay
 * (clk0/cpu0 100 MHz, flash ceiling 50 MHz), otherwise the UART baud
 * and the tick rate are both wrong.
 *
 * 2026-09-15: measured on both bitstreams, the iperf2 UDP rate scales
 * with these clocks -- 23.08 Mbit/s (100/50) vs 46.37 (200/100) vs
 * 29.75 (200 SYSCLK but flash held at 50). See
 * the port record (ethernet) §3.28.9.
 */

/* The agm,pins cells (function -> GPIO bank/bit -> dir) are generated:
 * tools/generate_pinctrl_dtsi.py turns this file's mcu-functions list plus
 * the SoC AF table (tools/agm_af_pins.yaml) into that fragment. Do not
 * hand-write them here -- tools/check_pinctrl.py fails if the effective
 * state and the pin list disagree. See the pin-routing notes §12.
 */
#include <agm/pinctrl-devmac.dtsi>
```

## src/main.c
```c
/*
 * Copyright (c) 2026 AgRV Contributors
 * SPDX-License-Identifier: Apache-2.0
 *
 * lan8720_iperf — iperf2-compatible TCP throughput client for the
 * AgRV2K on-die MAC0 + LAN8720 RMII PHY.
 *
 * Streams TCP data at an iperf2 server (`iperf -s` on the PC) for a
 * fixed duration and reports the throughput over UART. The upload path
 * is upstream zperf (CONFIG_NET_ZPERF, server and shell disabled) so
 * the wire format is the tested one this sample does not have to
 * implement.
 *
 * Sequence:
 *   1. Wait for the PHY link (the MAC follows it by itself: DT
 *      phy-handle -> the MAC driver subscribes to the PHY's link
 *      callback; same as samples/lan8720_link).
 *   2. Wait for the iface to go operational.
 *   3. One zperf TCP upload: LAN8720_IPERF_DURATION_MS at
 *      LAN8720_IPERF_PACKET_SIZE per segment.
 *   4. Print bytes / packets / errors / Mbit/s and a PASS/FAIL verdict
 *      against LAN8720_IPERF_MIN_MBITPS, then idle so the UART log can
 *      still be captured.
 *
 * There is deliberately no ICMP pre-flight before the upload.
 * net_icmp_init_ctx() dispatches a context on (family, type, code) only,
 * so *any* echo reply reaching the board satisfies the handler: on the
 * dev board (2026-09-15) it reported "PING OK" for 192.168.15.222, an
 * address that does not exist. Adding a source-address check did not
 * make it trustworthy either (it still reported a reply from a host the
 * wire showed the board never reached), so the upload result is the
 * only signal this sample reports.
 *
 * What this verifies:
 *   - eth_agm_send() really puts frames on the wire (descriptor rings +
 *     DMA), sustained -- lan8720_link only proves a single ICMP round
 *     trip.
 *   - The Zephyr net stack (TCP) underneath the AGM MAC.
 *   - A throughput baseline for spotting later regressions.
 *
 * What this does NOT verify:
 *   - The RX data path. The upload is one-directional; the server only
 *     sends ACKs back. RX under load (server pushes data) needs a
 *     different test.
 *   - UDP / PPS / jitter. zperf_udp_upload() exists; add a UDP variant
 *     here if that becomes interesting.
 *
 * iperf2 only. iperf3 speaks JSON-RPC over TCP and is NOT compatible.
 * zperf does not send iperf2's 28-byte control header, so a modern
 * iperf2 server still reports bytes/wallclock but also logs a cosmetic
 * "LAST PACKET NOT RECEIVED!!!" -- see README.md.
 *
 * Board IP:    CONFIG_NET_CONFIG_MY_IPV4_ADDR   (prj.conf, 192.168.15.1)
 * Server IP:   CONFIG_LAN8720_IPERF_SERVER_IP   (192.168.15.100)
 * Both must sit in the same /24.
 */

#include <errno.h>
#include <string.h>

#include <zephyr/kernel.h>
#include <zephyr/device.h>
#include <zephyr/net/net_if.h>
#include <zephyr/net/net_ip.h>
#include <zephyr/net/ethernet.h>
#include <zephyr/net/mii.h>
#include <zephyr/net/phy.h>
#include <zephyr/net/socket.h>
#include <zephyr/net/zperf.h>

#include <zephyr/logging/log.h>
LOG_MODULE_REGISTER(lan8720_iperf, LOG_LEVEL_INF);

/* zperf clamps an oversized packet_size to CONFIG_NET_ZPERF_MAX_PACKET_SIZE
 * and only logs a runtime warning; catch the mismatch at build time
 * instead, because it silently changes what "packet_size" means. */
BUILD_ASSERT(CONFIG_LAN8720_IPERF_PACKET_SIZE <= CONFIG_NET_ZPERF_MAX_PACKET_SIZE,
	     "LAN8720_IPERF_PACKET_SIZE must be <= CONFIG_NET_ZPERF_MAX_PACKET_SIZE");

/* zperf adds its own header on top of the payload we ask for, so the
 * segment must still fit the link MTU. For UDP the payload goes out as
 * one datagram (zperf's 40 B header is already inside packet_size):
 * +8 UDP +20 IP. IPv4 fragmentation is off in this sample, so an
 * oversized datagram is dropped at send time rather than split. */
#if defined(CONFIG_LAN8720_IPERF_PROTO_RAW)
/* RAW: packet_size is the whole frame, header included. */
BUILD_ASSERT(CONFIG_LAN8720_IPERF_RAW_PACKET_SIZE <= CONFIG_NET_ZPERF_MAX_PACKET_SIZE,
	     "LAN8720_IPERF_RAW_PACKET_SIZE must be <= CONFIG_NET_ZPERF_MAX_PACKET_SIZE");
BUILD_ASSERT(CONFIG_LAN8720_IPERF_RAW_PACKET_SIZE <= NET_ETH_MTU + 14,
	     "RAW frame must fit NET_ETH_MTU plus the Ethernet header");
#elif defined(CONFIG_LAN8720_IPERF_PROTO_UDP)
BUILD_ASSERT(CONFIG_LAN8720_IPERF_PACKET_SIZE + 28 <= NET_ETH_MTU,
	     "UDP packet_size + 8 (UDP) + 20 (IP) must fit NET_ETH_MTU");
#else
BUILD_ASSERT(CONFIG_LAN8720_IPERF_PACKET_SIZE + 40 <= NET_ETH_MTU,
	     "TCP packet_size + 20 (TCP) + 20 (IP) must fit NET_ETH_MTU");
#endif

static const struct device *const eth0 = DEVICE_DT_GET(DT_NODELABEL(eth0));
static const struct device *const phy0 = DEVICE_DT_GET(DT_NODELABEL(phy0));

#define LINK_WAIT_TIMEOUT_MS 10000
#define POLL_MS              100

static void on_link_state_change(const struct device *phy_dev,
				 struct phy_link_state *state,
				 void *user_data)
{
	ARG_UNUSED(phy_dev);
	ARG_UNUSED(user_data);

	if (state->is_up) {
		LOG_INF("LAN8720 link UP: %s Mb %s duplex",
			PHY_LINK_IS_SPEED_100M(state->speed) ? "100" : "10",
			PHY_LINK_IS_FULL_DUPLEX(state->speed) ? "full" : "half");
	} else {
		LOG_INF("LAN8720 link DOWN");
	}

	/* The MAC follows this PHY by itself: the eth0 node has
	 * phy-handle = <&phy0> and the MAC driver subscribes with
	 * phy_link_callback_set(), so the link state reaches the net stack
	 * without application glue. A PHY has exactly one callback slot, and
	 * it belongs to the MAC -- this function only reports what it sees. */
}

/* Wait for the PHY to report link up, replaying the callback on the way
 * (the PHY driver's monitor work owns the transition; this just makes
 * sure we do not race past it). */
static int wait_for_phy_link_up(int timeout_ms)
{
	int waited = 0;

	while (waited < timeout_ms) {
		struct phy_link_state state = { 0 };

		if (phy_get_link_state(phy0, &state) == 0 && state.is_up) {
			on_link_state_change(phy0, &state, NULL);
			return 0;
		}
		k_msleep(POLL_MS);
		waited += POLL_MS;
	}
	return -ETIMEDOUT;
}

/* Wait for the net stack to finish its post-carrier bringup. The carrier
 * goes on when the MAC driver hears the PHY's link callback;
 * net_if_is_up() only flips once update_operational_state() has run on
 * the net_mgmt workqueue, and a connect() before that is dropped. */
static int wait_for_iface_up(int timeout_ms)
{
	struct net_if *iface = net_if_get_default();
	int waited = 0;

	while (waited < timeout_ms) {
		if (iface != NULL && net_if_is_up(iface)) {
			return 0;
		}
		k_msleep(POLL_MS);
		waited += POLL_MS;
	}
	return -ETIMEDOUT;
}

int main(void)
{
	struct zperf_upload_params param = { 0 };
	struct zperf_results result = { 0 };
	struct net_sockaddr_in server = { 0 };
	struct phy_link_state initial = { 0 };
	uint64_t elapsed_us;
	uint64_t mbps_x100;
	int ret;

	LOG_INF("lan8720_iperf: iperf2 %s client, board %s -> server %s:%d",
#if defined(CONFIG_LAN8720_IPERF_PROTO_RAW)
		"RAW-L2",
#elif defined(CONFIG_LAN8720_IPERF_PROTO_UDP)
		"UDP",
#else
		"TCP",
#endif
		CONFIG_NET_CONFIG_MY_IPV4_ADDR,
		CONFIG_LAN8720_IPERF_SERVER_IP,
		CONFIG_LAN8720_IPERF_SERVER_PORT);
	LOG_INF("duration=%d ms  packet_size=%d B  min=%d Mbit/s",
		CONFIG_LAN8720_IPERF_DURATION_MS,
		CONFIG_LAN8720_IPERF_PACKET_SIZE,
		CONFIG_LAN8720_IPERF_MIN_MBITPS);
#if defined(CONFIG_LAN8720_IPERF_PROTO_UDP)
	LOG_INF("UDP target rate: %d kbit/s (x1024 bit/s)",
		CONFIG_LAN8720_IPERF_UDP_RATE_KBPS);
#endif

	if (!device_is_ready(eth0) || !device_is_ready(phy0)) {
		LOG_ERR("eth0/phy0 not ready -- check the bitstream pin list");
		return 0;
	}

	if (phy_get_link_state(phy0, &initial) == 0) {
		on_link_state_change(phy0, &initial, NULL);
	}

	if (wait_for_phy_link_up(LINK_WAIT_TIMEOUT_MS) < 0) {
		LOG_ERR("PHY link not up after %d ms, aborting",
			LINK_WAIT_TIMEOUT_MS);
		return 0;
	}
	if (wait_for_iface_up(LINK_WAIT_TIMEOUT_MS) < 0) {
		LOG_ERR("net iface not up after %d ms, aborting",
			LINK_WAIT_TIMEOUT_MS);
		return 0;
	}
	LOG_INF("link + iface up");

	server.sin_family = NET_AF_INET;
	server.sin_port = net_htons(CONFIG_LAN8720_IPERF_SERVER_PORT);
	ret = net_addr_pton(NET_AF_INET, CONFIG_LAN8720_IPERF_SERVER_IP,
			    &server.sin_addr);
	if (ret < 0) {
		LOG_ERR("net_addr_pton(%s) failed: %d",
			CONFIG_LAN8720_IPERF_SERVER_IP, ret);
		goto idle;
	}
	memcpy(&param.peer_addr_storage, &server, sizeof(server));

	param.duration_ms = CONFIG_LAN8720_IPERF_DURATION_MS;
#if defined(CONFIG_LAN8720_IPERF_PROTO_RAW)
	param.packet_size = CONFIG_LAN8720_IPERF_RAW_PACKET_SIZE;
	param.rate_kbps = CONFIG_LAN8720_IPERF_RAW_RATE_KBPS;
#else
	param.packet_size = CONFIG_LAN8720_IPERF_PACKET_SIZE;
#endif
#if defined(CONFIG_LAN8720_IPERF_PROTO_UDP)
	/* zperf paces the UDP loop by rate_kbps and divides by it, so this
	 * must be non-zero. The default is above the 100 Mb PHY, which
	 * makes the pacing a no-op and the run a max-throughput probe. */
	param.rate_kbps = CONFIG_LAN8720_IPERF_UDP_RATE_KBPS;
#else
	param.rate_kbps = 0U; /* TCP ignores it; 0 = no rate limit */
	/* Without TCP_NODELAY the stack waits up to 200 ms for an ACK
	 * before flushing each segment, which caps throughput far below
	 * the link rate. */
	param.options.tcp_nodelay = 1;
#endif

	LOG_INF("upload -> %s:%d for %d ms ...",
		CONFIG_LAN8720_IPERF_SERVER_IP,
		CONFIG_LAN8720_IPERF_SERVER_PORT,
		param.duration_ms);

#if defined(CONFIG_LAN8720_IPERF_PROTO_RAW)
	/* Hand-built Ethernet frame: broadcast destination (the host NIC
	 * accepts it at L2 and the kernel then drops the unknown
	 * ethertype), the board's own MAC as source. */
	uint8_t raw_hdr[14] = { 0xff, 0xff, 0xff, 0xff, 0xff, 0xff };
	struct net_linkaddr *link_addr = net_if_get_link_addr(net_if_get_default());
	struct zperf_raw_upload_params raw = { 0 };

	memcpy(&raw_hdr[6], link_addr->addr, 6);
	raw_hdr[12] = (CONFIG_LAN8720_IPERF_RAW_ETHERTYPE >> 8) & 0xff;
	raw_hdr[13] = CONFIG_LAN8720_IPERF_RAW_ETHERTYPE & 0xff;

	raw.duration_ms = CONFIG_LAN8720_IPERF_DURATION_MS;
	raw.rate_kbps = CONFIG_LAN8720_IPERF_RAW_RATE_KBPS;
	raw.packet_size = CONFIG_LAN8720_IPERF_RAW_PACKET_SIZE;
	raw.hdr = raw_hdr;
	raw.hdr_len = sizeof(raw_hdr);
	raw.if_index = net_if_get_by_iface(net_if_get_default());

	LOG_INF("RAW frame %u B (ethertype 0x%04x) -- capture with "
		"`tcpdump -i <if> ether proto 0x%04x`",
		raw.packet_size, CONFIG_LAN8720_IPERF_RAW_ETHERTYPE,
		CONFIG_LAN8720_IPERF_RAW_ETHERTYPE);

	ret = zperf_raw_upload(&raw, &result);
#elif defined(CONFIG_LAN8720_IPERF_PROTO_UDP)
	ret = zperf_udp_upload(&param, &result);
#else
	ret = zperf_tcp_upload(&param, &result);
#endif
	if (ret < 0) {
		LOG_ERR("zperf upload failed: %d (errno %d)", ret, errno);
		LOG_ERR("is iperf2 running on %s:%d?  (%s)",
			CONFIG_LAN8720_IPERF_SERVER_IP,
			CONFIG_LAN8720_IPERF_SERVER_PORT,
#if defined(CONFIG_LAN8720_IPERF_PROTO_UDP)
			"`iperf -s -u`");
#else
			"`iperf -s`");
#endif
		LOG_INF("Result: FAIL (upload error)");
		goto idle;
	}

	/* zperf reports elapsed time in two fields and the two protocols
	 * fill different ones:
	 *   TCP: only client_time_in_us (its own send loop) -- time_in_us
	 *        is receiver-reported and stays 0, which is what produced a
	 *        bogus "0.00 Mbit/s -> FAIL" before (dev board 2026-09-15).
	 *   UDP: time_in_us is the *server's* measured duration and
	 *        total_len is the bytes the server actually received, i.e.
	 *        the honest "what arrived on the wire" number. Prefer it.
	 *
	 * Mbit/s = bytes * 8 / us (the 1e6 cancels). Scale by 100 first so
	 * the print shows hundredths without floating point. */
#if defined(CONFIG_LAN8720_IPERF_PROTO_RAW)
	/* RAW has no peer report; the client loop time is all there is. */
	elapsed_us = result.client_time_in_us;
#elif defined(CONFIG_LAN8720_IPERF_PROTO_UDP)
	elapsed_us = (result.time_in_us != 0U) ? result.time_in_us
					       : result.client_time_in_us;
#else
	elapsed_us = (result.client_time_in_us != 0U) ? result.client_time_in_us
						      : result.time_in_us;
#endif

	if (elapsed_us == 0U) {
		mbps_x100 = 0U;
	} else {
		mbps_x100 = (result.total_len * 8ULL * 100ULL) /
			    elapsed_us;
	}

	LOG_INF("client sent %u packets, %llu bytes, %u send errors",
		result.nb_packets_sent,
		(unsigned long long)result.nb_packets_sent *
			(unsigned long long)result.packet_size,
		result.nb_packets_errors);
#if defined(CONFIG_LAN8720_IPERF_PROTO_RAW)
	LOG_INF("no peer report (RAW, TX only) over %llu us",
		(unsigned long long)elapsed_us);
	LOG_WRN("RAW mode: the only honest yardstick is the capture on the "
		"PC (frames x packet_size / wallclock)");
#elif defined(CONFIG_LAN8720_IPERF_PROTO_UDP)
	LOG_INF("server received %u packets, %u lost, %u out of order, "
		"jitter %u us, interval %llu us",
		result.nb_packets_rcvd, result.nb_packets_lost,
		result.nb_packets_outorder, result.jitter_in_us,
		(unsigned long long)elapsed_us);
#else
	LOG_INF("client handed %llu bytes to the socket over %llu us",
		(unsigned long long)result.total_len,
		(unsigned long long)elapsed_us);
#endif
	LOG_INF("Throughput: %llu.%02llu Mbit/s",
		(unsigned long long)(mbps_x100 / 100ULL),
		(unsigned long long)(mbps_x100 % 100ULL));

	if (result.nb_packets_errors > 0U) {
		LOG_WRN("%u send errors -- zperf counts net_buf exhaustion "
			"here; raise CONFIG_NET_BUF_TX_COUNT if the rate is low",
			result.nb_packets_errors);
	}

	if (CONFIG_LAN8720_IPERF_MIN_MBITPS > 0 &&
	    (mbps_x100 / 100ULL) < (uint64_t)CONFIG_LAN8720_IPERF_MIN_MBITPS) {
		LOG_WRN("Result: FAIL (below %d Mbit/s)",
			CONFIG_LAN8720_IPERF_MIN_MBITPS);
	} else {
		LOG_INF("Result: PASS");
	}

idle:
	/* Idle instead of returning, so the UART stays alive for capture
	 * and so a late server-side log can still be correlated. */
	while (1) {
		k_sleep(K_SECONDS(60));
	}
	return 0;
}
```
