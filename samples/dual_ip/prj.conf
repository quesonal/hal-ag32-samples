## CMakeLists.txt
```
# SPDX-License-Identifier: Apache-2.0

cmake_minimum_required(VERSION 3.28.0)

# Two fabric IPs in one bitstream (docs/CUSTOM-IP.md 1.5: the fabric has a
# single IP slot, so the IP that gen_vlog instantiates is a *wrapper*).
#
# AGM_LOGIC_IP names that wrapper: it is what build_bitstream.sh passes to
# gen_vlog as `-m <name>.v` (one macro per run) and what the IP-prepare step
# in <build>/logic_ip/ is called after. The other IPs are ordinary source
# files: AGM_USER_RTL is a list, every entry is staged into <build>/logic and
# registered in board.qsf, and Quartus resolves the sub-modules from there.
set(AGM_LOGIC_IP "dual_ip")
set(AGM_USER_RTL
    "${CMAKE_CURRENT_SOURCE_DIR}/ip/dual_ip.v"
    "${CMAKE_CURRENT_SOURCE_DIR}/ip/full_duplex_spi.v"
    "${CMAKE_CURRENT_SOURCE_DIR}/ip/custom_ip.v"
    "${CMAKE_CURRENT_SOURCE_DIR}/ip/ram2ahb.v"
    "${CMAKE_CURRENT_SOURCE_DIR}/ip/ahb2ram.v")

find_package(Zephyr REQUIRED HINTS $ENV{ZEPHYR_BASE})
project(dual_ip LANGUAGES C)

target_sources(app PRIVATE src/main.c src/ram_window.c)
```

## sample.yaml
```
# SPDX-License-Identifier: Apache-2.0
sample:
  name: dual_ip
  description: |
    Two fabric IPs in one bitstream: the vendor's custom_ip AHB RAM block and
    the full-duplex SPI IP, behind one wrapper (the fabric has a single IP
    slot, so the IP gen_vlog instantiates with -m is that wrapper -- see
    docs/CUSTOM-IP.md 1.5). The sample checks the RAM block through the cpld0
    window, then repeats samples/spi_quad_read's four flash reads to show the
    SPI IP still works with a second IP in the same fabric.
    Needs a bitstream synthesized from this sample's own logic/ directory, so
    the case is
    build_only.
tests:
  sample.dual_ip.agm_agrv2k_407:
    build_only: true
    platform_allow:
      - agrv2k_407
    integration_platforms:
      - agrv2k_407
    tags:
      - ci_build
      - hal_ag32
```

## prj.conf
```kconfig
# SPDX-License-Identifier: Apache-2.0
CONFIG_SERIAL=y
CONFIG_UART_CONSOLE=y
CONFIG_PRINTK=y
CONFIG_STDOUT_CONSOLE=y
CONFIG_XIP=y

# SPI driver + DMA (RX longer than four bytes goes through DMA).
CONFIG_SPI=y
CONFIG_DMA=y

# Required to use SPI_LINES_DUAL/QUAD: without this, spi_operation_t
# is uint16_t and the LINES_* bits (bits 16..17) get truncated away
# at compile time, so the driver's multiline dispatch never fires.
CONFIG_SPI_EXTENDED_MODES=y

# The fabric window is bound by drivers/misc/cpld_agm.c;
# CONFIG_CPLD_AGM defaults to y whenever a status-okay agm,agrv2k-cpld
# node exists (the board overlay enables cpld0).
```

## boards/agrv2k_407.overlay
```dts
/* SPDX-License-Identifier: Apache-2.0 */
/*
 * dual_ip pin map: the flash wiring of samples/spi_quad_read *plus* the
 * fabric window the wrapper (ip/dual_ip.v) splits between the two IPs.
 *
 * SPI0 goes through the full-duplex SPI IP exactly as it does there --
 * case A for the two IO pins and the MCU read-back, case C to tap the MCU's
 * SPI0 into the IP, case B for the IP to drive the pins. The only addition
 * is cpld0: the RAM block of the second IP is reached through the fabric
 * window at 0x60000000+0x000..0xFFF (see src/ram_window.c).
 */

/* `agm,spi-multiline = <2>` declares the bitstream's quad capability so the
 * driver accepts SPI_LINES_QUAD through the generic API; without it
 * spi_agm_check_config() returns -ENOTSUP. */
&spi0 {
	status = "okay";
	agm,spi-multiline = <2>;
};

&cpld0 {
	status = "okay";
};

&agrv2k_pins {
	mcu-functions =
		/* SPI0's two IO pins (the rest go through the IP below) */
		"SPI0_WPN_IO2",
		"SPI0_HOLDN_IO3",

		/* Everything below is the shared board map, unchanged. */
		"GPIO4_1",
		"GPIO4_2",
		"GPIO4_3",
		"GPIO4_4",

		"GPIO6_2",
		"GPIO6_4",
		"GPIO6_5",
		"GPIO6_6",

		"USB0_ID",

		"UART0_UARTRXD",
		"UART0_UARTTXD",
		"UART1_UARTTXD",
		"UART1_UARTRXD",

		"CAN0_TX0",
		"CAN0_RX0",

		"I2C0_SDA",
		"I2C0_SCL",

		"GPTIMER1_CH0",

		/* SPI0's own MISO and IO0: the IP drives those pins, but SPI0
		 * still has to *read* them (0x03 needs IO1, dual/quad need IO0
		 * as well) -- see the comment above. */
		"SPI0_SO_IO1",
		"SPI0_SI_IO0";

	mcu-pins =
		<98>, <95>,
		<51>, <52>, <53>, <54>,
		<23>, <24>, <29>, <30>,
		<78>,
		<69>, <68>, <67>, <66>,
		<39>, <38>,
		<36>, <35>,
		<7>,
		<97>, <92>;

	/* SPI0_SI_IO0 is an output function, so its row needs the direction
	 * spelled out to get the read-back path; SPI0_SO_IO1 is an input
	 * function and needs no direction. */
	agm,mcu-input-pins = <92>;

	/* Case B: the IP drives/reads the flash pins. */
	cpld-signals = "csn", "sck", "si_io0", "so_io1";
	cpld-pins = <96>, <93>, <92>, <97>;
	cpld-directions = "output", "output", "output", "input";

	/* Case C: the MCU's SPI0 is tapped into those IP ports. */
	mcu-cpld-functions = "SPI0_CSN", "SPI0_SCK", "SPI0_SI_IO0";
	mcu-cpld-signals = "csn", "sck", "si_io0";
	mcu-cpld-directions = "", "", "output";
};

&dma0 {
	status = "okay";
};
```

## src/main.c
```c
/*
 * Copyright (c) 2026 AgRV Contributors
 * SPDX-License-Identifier: Apache-2.0
 *
 * dual_ip — two fabric IPs in one bitstream.
 *
 * This file is samples/spi_quad_read/src/main.c verbatim except for the
 * printk prefix (the SPI half is unchanged on purpose, so its output stays
 * comparable with the measured single-IP run) plus the call to
 * dual_ip_ram_test() and the summary at the bottom: the point of this sample
 * is that the SPI IP keeps working byte for byte while a *second* IP
 * (the vendor's custom_ip RAM block) sits in the same fabric -- the wrapper
 * that instantiates both is ip/dual_ip.v, see docs/CUSTOM-IP.md 1.5.
 *
 * The RAM half runs first and prints its own verdict; the SPI half follows.
 *
 * The AgRV2K phase engine has three documented constraints (vendor
 * "AG32 下 SPI 的扩展使用", page 1):
 *
 *   1. a transfer starts with TX (never RX);
 *   2. TX and RX do not overlap (TX first, then RX);
 *   3. RX is the last phase.
 *
 * The driver-level multiline wrapper
 * (spi_agm_transceive_multiline(), inside drivers/spi/spi_agm.c) turns a
 * generic transceive() request that asked for SPI_LINES_DUAL/QUAD into a
 * phase list with one single-line TX phase for the command+address, an
 * optional single-line DUMMY phase for the wait states, and one RX phase
 * on the requested line mode. This sample verifies three of those shapes
 * against the on-board SPI NOR flash:
 *
 *   - RDID (0x9F) on single line: the baseline. No dummy phase, 3 data
 *     bytes back. The same path used by samples/spi_flash_id, which
 *     proves the controller and bitstream are wired up.
 *   - 0x3B on dual lines: 1-byte command + 3-byte address + 8 dummy
 *     clocks (the wrapper always inserts one byte of filler between the
 *     command+address phase and the data phase, which is the 8-clock
 *     wait state the W25Q16 family of 0x3B/0x6B/0xEB fast reads wants)
 *     + N data bytes on MOSI+MISO. Reads at 0x000000 by default.
 *   - 0x6B on quad lines: same shape, four data lines. Reads at 0x000000
 *     by default.
 *
 * All three are read-only and target the same flash region, so they
 * leave the flash content untouched and cross-check each other: the
 * three patterns must read the same first three bytes (JEDEC ID).
 *
 * Two things have to be in place for the multi-line half to run at all:
 * the bitstream must route IO2/IO3 to the flash's WP#/HOLD# pins and the
 * node must declare `agm,spi-multiline` (see the board overlay), and
 * CONFIG_SPI_EXTENDED_MODES must be set (see prj.conf) -- without it
 * spi_operation_t is 16 bits wide, the SPI_LINES_* bits are truncated at
 * compile time and the request silently stays on the single-line path.
 */

#include <errno.h>
#include <stdint.h>

#include <zephyr/device.h>
#include <zephyr/devicetree.h>
#include <zephyr/drivers/spi.h>
#include <zephyr/kernel.h>
#include <zephyr/sys/printk.h>

#include "ram_window.h"
#include <zephyr/sys/util.h>

#if !DT_HAS_COMPAT_STATUS_OKAY(agm_agrv2k_spi)
#error "no agm,agrv2k-spi node is enabled: enable one in the sample overlay"
#endif

#define SPI_AGM_DEV_ENTRY(node) DEVICE_DT_GET(node),

static const struct device *const spi_controllers[] = {
	DT_FOREACH_STATUS_OKAY(agm_agrv2k_spi, SPI_AGM_DEV_ENTRY)
};

/* JEDEC commands the multiline path accepts (single-line cmd+addr on the
 * first phase, one dummy byte = 8 clocks of wait state, then data on the
 * requested line mode). */
#define SPI_FLASH_CMD_RDID_SINGLE 0x9FU
#define SPI_FLASH_CMD_READ_SINGLE 0x03U
#define SPI_FLASH_CMD_READ_DUAL   0x3BU
#define SPI_FLASH_CMD_READ_QUAD   0x6BU

/* 1 MHz is a safe bring-up rate for an unknown board. */
#define SPI_FLASH_FREQ            1000000U

#define SPI_FLASH_READ_LEN        16U

/* The sample picks its own address: it walks the page starts of the first
 * sector and uses the first 16-byte window that is not all 0xff. A blank
 * window makes "the reads agree" meaningless -- the multiline bring-up
 * once reported a false pass on an erased page
 * (the port record (peripherals) 3.27.9) -- so a fully erased sector is
 * reported as INCONCLUSIVE rather than as a pass.
 *
 * The dev board's usual content is what samples/spi_flash_rw leaves behind
 * (its page pattern at base + 3 * 256), which this scan finds on its own.
 */
#define SPI_FLASH_SCAN_BYTES      0x1000U
#define SPI_FLASH_SCAN_STEP       0x100U

static void print_bytes(const char *tag, const uint8_t *buf, size_t len)
{
	printk("%s =", tag);
	for (size_t i = 0U; i < len; i++) {
		printk(" %02x", buf[i]);
	}
	printk("\n");
}

/* One single-line RDID read -- this is the shape spi_flash_id exercises
 * and is the baseline we expect to keep working after the multiline path
 * is added. The driver returns -ENOTSUP for SPI_LINES_QUAD when the
 * bitstream's agm,spi-multiline property is 0 (the shipped
 * example_board.bin), so this sample asserts the property is set: see
 * boards/agrv2k_407.overlay.
 */
static int run_single_rdid(const struct device *spi, uint8_t *rdid)
{
	const uint8_t cmd = SPI_FLASH_CMD_RDID_SINGLE;
	struct spi_buf tx_buf = { .buf = (void *)&cmd, .len = 1U };
	struct spi_buf rx_bufs[2] = {
		{ .buf = NULL, .len = 1U },
		{ .buf = rdid, .len = 3U },
	};
	const struct spi_buf_set tx_set = { .buffers = &tx_buf, .count = 1U };
	const struct spi_buf_set rx_set = { .buffers = rx_bufs, .count = 2U };
	const struct spi_config cfg = {
		.frequency = SPI_FLASH_FREQ,
		.operation = SPI_OP_MODE_CONTROLLER | SPI_WORD_SET(8) |
			     SPI_TRANSFER_MSB,
		.slave = 0,
		.cs = { .cs_is_gpio = false },
	};

	return spi_transceive(spi, &cfg, &tx_set, &rx_set);
}

/* Single-line 0x03 read of `len` bytes at `addr` — the reference the
 * multiline reads have to reproduce.
 *
 * This is the shape the *single-line* half of the driver implements: the
 * RX buffer set mirrors the TX buffer set, with a NULL slot standing in
 * for the command/address bytes (spi_agm_collect() reports those slots as
 * 0xff, which is what the SPI API's buffer-set convention asks for).
 */
static int run_single_read(const struct device *spi, uint32_t addr, uint8_t *rx, size_t len)
{
	const uint8_t cmd[4] = {
		SPI_FLASH_CMD_READ_SINGLE,
		(uint8_t)(addr >> 16), (uint8_t)(addr >> 8), (uint8_t)addr,
	};
	struct spi_buf tx_buf = { .buf = (void *)cmd, .len = sizeof(cmd) };
	struct spi_buf rx_bufs[2] = {
		{ .buf = NULL, .len = sizeof(cmd) },
		{ .buf = rx, .len = len },
	};
	const struct spi_buf_set tx_set = { .buffers = &tx_buf, .count = 1U };
	const struct spi_buf_set rx_set = { .buffers = rx_bufs, .count = 2U };
	const struct spi_config cfg = {
		.frequency = SPI_FLASH_FREQ,
		.operation = SPI_OP_MODE_CONTROLLER | SPI_WORD_SET(8) |
			     SPI_TRANSFER_MSB,
		.slave = 0,
		.cs = { .cs_is_gpio = false },
	};

	return spi_transceive(spi, &cfg, &tx_set, &rx_set);
}

/* Dual- or quad-line read of `len` bytes at `addr`: 1 command byte + 3
 * address bytes on a single line, 8 dummy clocks, then `len` data bytes on
 * the requested number of lines.
 *
 * The multiline wrapper (spi_agm_transceive_multiline()) is stricter than
 * the single-line path: it takes **exactly one** TX buffer (the
 * command+address frame) and **exactly one** RX buffer (the data phase),
 * and answers -ENOTSUP for anything else. So do not mirror tx_bufs here
 * with a NULL slot — that shape is silent about the command phase in the
 * single-line path, but the wrapper has no cmd/addr slots in its RX
 * phase to fill and rejects the request outright.
 *
 * SPI_LINES_QUAD is also refused with -ENOTSUP when the bitstream does not
 * declare `agm,spi-multiline = 2`, so a positive return here is the
 * bitstream-routing verdict.
 */
static int run_multiline_read(const struct device *spi, uint8_t command, uint32_t addr,
			      uint8_t *rx, size_t len, uint32_t lines)
{
	const uint8_t frame[4] = {
		command,
		(uint8_t)(addr >> 16), (uint8_t)(addr >> 8), (uint8_t)addr,
	};
	struct spi_buf tx_buf = { .buf = (void *)frame, .len = sizeof(frame) };
	struct spi_buf rx_buf = { .buf = rx, .len = len };
	const struct spi_buf_set tx_set = { .buffers = &tx_buf, .count = 1U };
	const struct spi_buf_set rx_set = { .buffers = &rx_buf, .count = 1U };
	const struct spi_config cfg = {
		.frequency = SPI_FLASH_FREQ,
		.operation = SPI_OP_MODE_CONTROLLER | SPI_WORD_SET(8) |
			     SPI_TRANSFER_MSB | lines,
		.slave = 0,
		.cs = { .cs_is_gpio = false },
	};

	return spi_transceive(spi, &cfg, &tx_set, &rx_set);
}

/* First page-aligned 16-byte window inside the first sector that is not
 * all 0xff, or -ENOENT when the whole sector is blank. */
static int find_pattern_addr(const struct device *spi, uint32_t *addr)
{
	for (uint32_t a = 0U; a < SPI_FLASH_SCAN_BYTES; a += SPI_FLASH_SCAN_STEP) {
		uint8_t probe[SPI_FLASH_READ_LEN];
		int ret = run_single_read(spi, a, probe, sizeof(probe));

		if (ret < 0) {
			return ret;
		}

		for (size_t i = 0U; i < sizeof(probe); i++) {
			if (probe[i] != 0xFFU) {
				*addr = a;
				return 0;
			}
		}
	}

	return -ENOENT;
}

int main(void)
{
	bool any_pass = false;
	int ram_ret;
	int alias_ret;

	printk("\ndual_ip: generic-API SPI_LINES_DUAL/QUAD over the "
	       "phase engine\n");

	/* RAM block first (its window is what the wrapper decodes), then the SPI
	 * half, then the decode/aliasing check -- which is the access that
	 * touches the SPI IP's side of the window, and therefore the one most
	 * likely to stall on a bad bitstream. Each half announces itself, so a
	 * hang says where it happened. */
	printk("dual_ip: RAM block (custom_ip, 0x60000000+0x000..0xFFF)\n");
	ram_ret = dual_ip_ram_test();
	printk("dual_ip: SPI IP (full_duplex_spi) four flash reads\n");

	for (size_t i = 0U; i < ARRAY_SIZE(spi_controllers); i++) {
		const struct device *spi = spi_controllers[i];
		uint8_t rdid[3] = { 0U, 0U, 0U };
		uint8_t ref_buf[SPI_FLASH_READ_LEN] = { 0 };
		uint8_t dual_buf[SPI_FLASH_READ_LEN] = { 0 };
		uint8_t quad_buf[SPI_FLASH_READ_LEN] = { 0 };
		uint32_t addr = 0U;
		int ret;

		printk("\ndual_ip: %s\n", spi->name);

		if (!device_is_ready(spi)) {
			printk("dual_ip: not ready\n");
			continue;
		}

		ret = run_single_rdid(spi, rdid);
		if (ret < 0) {
			printk("dual_ip: single RDID failed (%d)\n", ret);
			continue;
		}

		print_bytes("dual_ip: RDID  ", rdid, sizeof(rdid));

		ret = find_pattern_addr(spi, &addr);
		if (ret == -ENOENT) {
			printk("dual_ip: %s -> INCONCLUSIVE (the first %u bytes "
			       "are blank; program a pattern first, e.g. with "
			       "samples/spi_flash_rw)\n", spi->name,
			       (unsigned int)SPI_FLASH_SCAN_BYTES);
			continue;
		}
		if (ret < 0) {
			printk("dual_ip: scan read failed (%d)\n", ret);
			continue;
		}

		printk("dual_ip: pattern at %#06x\n", (unsigned int)addr);

		/* Single-line 0x03 reference: the two multiline reads must
		 * reproduce exactly these bytes, not merely agree with each
		 * other. */
		ret = run_single_read(spi, addr, ref_buf, sizeof(ref_buf));
		if (ret < 0) {
			printk("dual_ip: 0x03 reference read failed (%d)\n", ret);
			continue;
		}

		print_bytes("dual_ip: 0x03  ", ref_buf, sizeof(ref_buf));

		ret = run_multiline_read(spi, SPI_FLASH_CMD_READ_DUAL, addr,
					 dual_buf, sizeof(dual_buf), SPI_LINES_DUAL);
		if (ret < 0) {
			printk("dual_ip: dual read failed (%d)\n", ret);
		} else {
			print_bytes("dual_ip: DUAL  ", dual_buf, sizeof(dual_buf));
		}

		ret = run_multiline_read(spi, SPI_FLASH_CMD_READ_QUAD, addr,
					 quad_buf, sizeof(quad_buf), SPI_LINES_QUAD);
		if (ret < 0) {
			printk("dual_ip: quad read failed (%d)\n", ret);
		} else {
			print_bytes("dual_ip: QUAD  ", quad_buf, sizeof(quad_buf));
		}

		/* Verdict. -ENOTSUP from either multiline call means the
		 * bitstream does not declare agm,spi-multiline = 2, or the
		 * request never left the single-line path because
		 * CONFIG_SPI_EXTENDED_MODES is off (spi_operation_t is then
		 * 16 bits wide and the SPI_LINES_* bits are truncated away --
		 * see prj.conf). */
		if (ret < 0) {
			printk("dual_ip: %s -> FAIL (multiline unsupported or "
			       "errored)\n", spi->name);
		} else if ((memcmp(dual_buf, ref_buf, sizeof(ref_buf)) == 0) &&
			   (memcmp(quad_buf, ref_buf, sizeof(ref_buf)) == 0)) {
			printk("dual_ip: %s -> PASS (0x03, 0x3B and 0x6B agree "
			       "byte for byte)\n", spi->name);
			any_pass = true;
		} else {
			printk("dual_ip: %s -> FAIL (multiline data differs from "
			       "0x03)\n", spi->name);
		}
	}

	alias_ret = dual_ip_alias_test();

	printk("\ndual_ip: SPI %s / RAM %s / decode %s\n",
	       any_pass ? "PASS" : "FAIL (no controller produced a readable "
	       "multiline page)",
	       (ram_ret == 0) ? "PASS" : "FAIL",
	       (alias_ret == 0) ? "PASS" : "FAIL");
	printk("dual_ip: %s (two IPs in one fabric: custom_ip RAM + "
	       "full_duplex_spi)\n",
	       (any_pass && ram_ret == 0 && alias_ret == 0) ? "PASS" : "FAIL");

	while (true) {
		k_msleep(1000);
	}
}
```

## src/ram_window.c
```c
/*
 * Copyright (c) 2026 AgRV Contributors
 * SPDX-License-Identifier: Apache-2.0
 *
 * dual_ip — the AHB RAM half of the two-IP test.
 *
 * ip/dual_ip.v gives 0x60000000 + 0x000..0x7FF to the vendor custom_ip RAM
 * block and everything above that to the SPI IP. The block is instantiated
 * with RAM_SIZE = 2048 rather than the vendor example's 4096: the user-logic
 * LogicLock region holds 4 M9K blocks, and the SPI IP's RX FIFO already uses
 * one (4 KiB of RAM would be 4 more -- one too many for Quartus; see
 * ip/dual_ip.v).
 *
 * Two functions, and main.c runs them on either side of the SPI half:
 *   dual_ip_ram_test()   writes/reads six words of the block;
 *   dual_ip_alias_test() writes one block higher (the SPI IP's side) and
 *                        checks the RAM did not change -- that is the address
 *                        decode; without it both IPs would answer everything.
 *
 * WARNING: an access the fabric does not answer never completes (no
 * hreadyout, no fault), so a wrong bitstream hangs instead of printing a
 * failure. main.c prints a banner before each half, which is what makes the
 * point of the hang identifiable from the capture.
 */

#include <errno.h>

#include <zephyr/device.h>
#include <zephyr/drivers/misc/cpld_agm.h>
#include <zephyr/sys/printk.h>

#include "ram_window.h"

#define CPLD_NODE DT_NODELABEL(cpld0)

/* The RAM block: 2 KiB, decoded by the wrapper as haddr[15:11] == 0. */
#define RAM_BLOCK_SIZE 0x0800U
/* One word past it -- the SPI IP's side of the window. */
#define RAM_ALIAS_OFF  0x0800U

static const struct device *const cpld = DEVICE_DT_GET(CPLD_NODE);

/* Spread over the block, including its last word (the vendor example checks
 * every word; six of them catch an address decode that wraps or drops bits,
 * which is what actually goes wrong here). */
static const uint32_t offsets[] = {
	0x000U, 0x004U, 0x100U, 0x400U, 0x600U, 0x7fcU,
};

static uint32_t pattern_for(size_t i)
{
	return 0xa5a50000U ^ ((uint32_t)i * 0x01010101U);
}

int dual_ip_ram_test(void)
{
	uint32_t written[ARRAY_SIZE(offsets)];
	uint32_t val;
	int ret;

	printk("dual_ip: RAM window 0x%08x+0x%03x.. (custom_ip, "
	       "ip/dual_ip.v)\n", (uint32_t)DT_REG_ADDR(CPLD_NODE),
	       RAM_BLOCK_SIZE - 1U);

	if (!device_is_ready(cpld)) {
		printk("dual_ip: RAM: cpld0 not ready\n");
		return -ENODEV;
	}

	for (size_t i = 0U; i < ARRAY_SIZE(offsets); i++) {
		written[i] = pattern_for(i);
		ret = agm_cpld_write32(cpld, offsets[i], written[i]);
		if (ret < 0) {
			printk("dual_ip: RAM: write +0x%03x failed (%d)\n",
			       offsets[i], ret);
			return ret;
		}
	}

	for (size_t i = 0U; i < ARRAY_SIZE(offsets); i++) {
		ret = agm_cpld_read32(cpld, offsets[i], &val);
		if (ret < 0) {
			printk("dual_ip: RAM: read +0x%03x failed (%d)\n",
			       offsets[i], ret);
			return ret;
		}
		if (val != written[i]) {
			printk("dual_ip: RAM: +0x%03x read 0x%08x, "
			       "0x%08x expected\n", offsets[i], val, written[i]);
			return -EIO;
		}
	}

	printk("dual_ip: RAM: %u word(s) read back -> PASS\n",
	       (unsigned int)ARRAY_SIZE(offsets));
	return 0;
}

int dual_ip_alias_test(void)
{
	uint32_t val;
	int ret;

	/* The decode: a write above the block must not reach the RAM. This one
	 * goes to the SPI IP's mem_ahb port, which answers (the same access
	 * completes on the single-IP bitstream too), it just must not alias. */
	ret = agm_cpld_write32(cpld, RAM_ALIAS_OFF, ~pattern_for(0));
	if (ret < 0) {
		printk("dual_ip: RAM: write +0x%03x failed (%d)\n",
		       RAM_ALIAS_OFF, ret);
		return ret;
	}
	ret = agm_cpld_read32(cpld, offsets[0], &val);
	if (ret < 0 || val != pattern_for(0)) {
		printk("dual_ip: RAM: +0x%03x changed to 0x%08x after a write "
		       "to +0x%03x -- the two IP windows are not decoded\n",
		       offsets[0], val, RAM_ALIAS_OFF);
		return -EIO;
	}

	printk("dual_ip: RAM: +0x%03x does not alias into the block -> PASS\n",
	       RAM_ALIAS_OFF);
	return 0;
}
```

## src/ram_window.h
```c
/*
 * Copyright (c) 2026 AgRV Contributors
 * SPDX-License-Identifier: Apache-2.0
 */

#ifndef DUAL_IP_RAM_WINDOW_H_
#define DUAL_IP_RAM_WINDOW_H_

/* Write/read the RAM block of ip/dual_ip.v through the cpld0 window. Returns 0
 * when every word read back, a negative errno otherwise. */
int dual_ip_ram_test(void);

/* The decode check: a write one block above the RAM must not reach it. Kept
 * separate so main.c can run it *after* the SPI half -- it touches the SPI
 * IP's side of the window, and that is the access most likely to stall. */
int dual_ip_alias_test(void);

#endif /* DUAL_IP_RAM_WINDOW_H_ */
```
