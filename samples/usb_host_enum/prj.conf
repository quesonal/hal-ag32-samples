## CMakeLists.txt
```
# SPDX-License-Identifier: Apache-2.0

cmake_minimum_required(VERSION 3.28.0)
find_package(Zephyr REQUIRED HINTS $ENV{ZEPHYR_BASE})
project(usb_host_enum)

FILE(GLOB app_sources src/*.c)
target_sources(app PRIVATE ${app_sources})
```

## sample.yaml
```
# SPDX-License-Identifier: Apache-2.0
sample:
  name: usb_host_enum
  description: |
    USB0 host-mode enumeration sample for AgRV2K (drivers/usb/uhc/uhc_agm.c,
    ported from TinyUSB's ChipIdea/EHCI host driver). The board acts as a USB
    host: plug any full-speed device into the USB0 connector and the host
    stack runs it through bus reset, GET_DESCRIPTOR(8), SET_ADDRESS,
    GET_DESCRIPTOR(18) and SET_CONFIGURATION, then the sample's class prints
    the device's address, speed, VID/PID and class codes with a PASS line.
    Unplugging prints the removal line. No GPIOs or extra wiring are needed
    beyond the USB0 cable; the bitstream must be in USB0 host mode.
tests:
  sample.usb_host_enum.agm_agrv2k_407:
    build_only: true
    platform_allow:
      - agrv2k_407
    integration_platforms:
      - agrv2k_407
    tags:
      - ci_build
      - hal_ag32
      - drivers
      - usb
      - uhc
      - host
      - agrv2k

  # Device-testing (HIL): the controller and the host stack come up with
  # nothing plugged into USB0 -- this is the "no device required" half of the
  # host path, and it also proves the usbh threads and the class registration
  # did not fall over at boot.
  sample.usb_host_enum.hil.agm_agrv2k_407:
    harness: console
    harness_config:
      type: one_line
      regex:
        - "main: USB0 host is up"
    timeout: 60
    platform_allow:
      - agrv2k_407
    integration_platforms:
      - agrv2k_407
    tags:
      - hil
      - hal_ag32
      - usb
```

## prj.conf
```kconfig
# SPDX-License-Identifier: Apache-2.0
#
# AgRV2K USB0 host-mode enumeration sample (uhc_agm + the Zephyr host stack).

# USB host stack; it selects UHC_DRIVER, and UHC_AGM follows from the
# enabled &uhc0 node (see boards/agrv2k_407.overlay).
CONFIG_USB_HOST_STACK=y

CONFIG_LOG=y
CONFIG_LOG_MODE_IMMEDIATE=y
# Bump these to DBG when the host path misbehaves: the stack then logs every
# chapter-9 request with its completion error, and the driver logs every armed
# qTD chain.
CONFIG_USBH_LOG_LEVEL_INF=y
CONFIG_UHC_DRIVER_LOG_LEVEL_INF=y

# Enumeration runs in the host stack's own threads (the bus thread drives the
# control transfers and parses the descriptors), so both need room for the
# logging in this sample.
CONFIG_MAIN_STACK_SIZE=4096
CONFIG_USBH_STACK_SIZE=4096

# One device at a time is enough for this sample's purpose.
CONFIG_USBH_USB_DEVICE_MAX=2
```

## boards/agrv2k_407.overlay
```dts
/*
 * Copyright (c) 2026 AgRV Contributors
 * SPDX-License-Identifier: Apache-2.0
 */

/*
 * USB0 as a host controller.
 *
 * The board enables the *device* role by default (zephyr_udc0: &usb0). USB0
 * is one piece of silicon with one role at a time, so the two nodes are
 * mutually exclusive: disable usb0, enable the host node and give it the
 * zephyr_uhc0 label the host stack looks up.
 *
 * The bitstream has to present USB0 in host mode too (or OTG, which the
 * driver overrides with USBMODE.CM = host); DP/DM are the fixed PIN_70/71
 * pins and need no pinctrl.
 */

&usb0 {
	status = "disabled";
};

zephyr_uhc0: &uhc0 {
	status = "okay";
};
```

## src/main.c
```c
/*
 * Copyright (c) 2026 AgRV Contributors
 * SPDX-License-Identifier: Apache-2.0
 */

/*
 * AgRV2K USB host enumeration sample.
 *
 * The Zephyr host stack (subsys/usb/host) does the work: usbh_init() +
 * usbh_enable() bring up the controller and leave it watching the root port,
 * and every device the stack enumerates is offered to each registered class
 * through its filter table. This sample registers one class with an empty
 * filter table (an empty table matches everything), so it is handed every
 * device that finishes enumeration -- whatever it is, with no class driver
 * needed -- and prints what the stack learned about it.
 *
 * Output shape (one PASS/FAIL verdict per event, per the repo's sample
 * convention):
 *   Device connected, full speed          <- uhc_agm
 *   PASS: enumerated a USB device         <- this sample
 *     address / speed / VID:PID / class   <- from the device descriptor
 *   device removed
 */

#include <zephyr/device.h>
#include <zephyr/devicetree.h>
#include <zephyr/kernel.h>
#include <zephyr/usb/usbh.h>
#include <zephyr/usb/usb_ch9.h>

#include <zephyr/logging/log.h>
LOG_MODULE_REGISTER(main, LOG_LEVEL_INF);

/* The controller node the board overlay enabled and labelled. */
USBH_CONTROLLER_DEFINE(uhs_ctx, DEVICE_DT_GET(DT_NODELABEL(zephyr_uhc0)));

struct host_enum_ctx {
	atomic_t enumerated;
	atomic_t removed;
};

static struct host_enum_ctx enum_ctx;

static int enum_init(struct usbh_class_data *const c_data)
{
	LOG_INF("host class '%s' ready", c_data->name);

	return 0;
}

static int enum_completion(struct usbh_class_data *const c_data,
			   struct uhc_transfer *const xfer)
{
	ARG_UNUSED(c_data);

	LOG_DBG("transfer %p finished, err %d", (void *)xfer, xfer->err);

	return 0;
}

static int enum_probe(struct usbh_class_data *const c_data,
		      struct usb_device *const udev, const uint8_t iface)
{
	const struct usb_device_descriptor *desc = &udev->dev_desc;

	ARG_UNUSED(c_data);
	ARG_UNUSED(iface);

	LOG_INF("PASS: enumerated a USB device");
	LOG_INF("  address   %u", udev->addr);
	LOG_INF("  speed     %u", (unsigned int)udev->speed);
	LOG_INF("  VID:PID   %04x:%04x", (unsigned int)desc->idVendor,
		(unsigned int)desc->idProduct);
	LOG_INF("  bcdUSB    %04x", (unsigned int)desc->bcdUSB);
	LOG_INF("  bcdDevice %04x", (unsigned int)desc->bcdDevice);
	LOG_INF("  class     %02x/%02x/%02x", desc->bDeviceClass,
		desc->bDeviceSubClass, desc->bDeviceProtocol);
	LOG_INF("  maxpacket %u, configurations %u", desc->bMaxPacketSize0,
		desc->bNumConfigurations);

	atomic_inc((atomic_t *)&enum_ctx.enumerated);

	return 0;
}

static int enum_removed(struct usbh_class_data *const c_data)
{
	ARG_UNUSED(c_data);

	LOG_INF("device removed");
	atomic_inc((atomic_t *)&enum_ctx.removed);

	return 0;
}

static int enum_suspended(struct usbh_class_data *const c_data)
{
	ARG_UNUSED(c_data);

	LOG_INF("bus suspended");

	return 0;
}

static int enum_resumed(struct usbh_class_data *const c_data)
{
	ARG_UNUSED(c_data);

	LOG_INF("bus resumed");

	return 0;
}

static struct usbh_class_api enum_api = {
	.init = enum_init,
	.completion_cb = enum_completion,
	.probe = enum_probe,
	.removed = enum_removed,
	.suspended = enum_suspended,
	.resumed = enum_resumed,
};

/* Empty filter table -> the class is offered every enumerated device. */
USBH_DEFINE_CLASS(usb_host_enum, &enum_api, &enum_ctx, NULL);

int main(void)
{
	int ret;

	LOG_INF("AgRV2K USB host enumeration sample");

	ret = usbh_init(&uhs_ctx);
	if (ret != 0) {
		LOG_ERR("usbh_init failed: %d", ret);
		return 0;
	}

	ret = usbh_enable(&uhs_ctx);
	if (ret != 0) {
		LOG_ERR("usbh_enable failed: %d", ret);
		return 0;
	}

	LOG_INF("USB0 host is up -- plug a device into the USB0 connector");

	while (true) {
		k_sleep(K_SECONDS(5));

		if (atomic_get(&enum_ctx.enumerated) == 0) {
			LOG_INF("no device yet (bitstream in USB0 host mode?)");
		}
	}

	return 0;
}
```
